## boards/arm/akdk_bt1/Kconfig
```kconfig
config BOARD_ENABLE_DCDC
    bool "Enable DCDC mode"
    select SOC_DCDC_NRF52X
    default y
    depends on BOARD_AKDK_BT1

if BOARD_AKDK_BT1

if USB_DEVICE_STACK

config USB_NRFX
    default y

endif # USB_DEVICE_STACK

config BT_CTLR
    default BT

endif
```

## boards/shields/split_ergo_tb/Kconfig
```kconfig
config SHIELD_SPLIT_ERGO_TB_LEFT
    def_bool $(shields_list_contains,split_ergo_tb_left)
config SHIELD_SPLIT_ERGO_TB_RIGHT
    def_bool $(shields_list_contains,split_ergo_tb_right)


if SHIELD_SPLIT_ERGO_TB_RIGHT

config ZMK_KEYBOARD_NAME
    default "split_ergo_tb"

endif

if SHIELD_SPLIT_ERGO_TB_LEFT || SHIELD_SPLIT_ERGO_TB_RIGHT

config ZMK_SPLIT
    default y

endif
```
